/*************************************************
* @Author: fuqingchen@whut.edu.cn
* @Date: 2018-11-26 20:48:54
* @Description: 步进电机控制实验
*************************************************/

#include <reg51.h>
unsigned char turn[] = { 0x01,0x03,0x02,0x06,0x04,0x0C,0x08,0x09 };
unsigned int i = 0;

/*************************************************
* @Description: 延时函数
* @Input: t:延长的时间
*************************************************/
void delay(unsigned int t) {
	unsigned char i;
	while (t--) {
		for (i = 0; i<120; i++);
	}
}

/*************************************************
* @Description: 使步进电机正转
*************************************************/
void positive() interrupt 0 {
	//TODO:使步进电机正转
	i++;
	if (i>=8)
	{
		i = 0;
	}
	P0 = turn[i];
	delay(100);
	P0 = 0xff;
}

/*************************************************
* @Description: 使步进电机反转
*************************************************/
void negitive()  interrupt 2 {
	//TODO:使步进电机反转
	i--;
	if (i <= 0)
	{
		i = 7;
	}
	P0 = turn[i];
	delay(100);
	P0 = 0xff;
}

void main() {
	EA = 1;	//允许总中断
	EX0 = 1; EX1 = 1;	//允许外部中断0,1
	IT0 = 0; IT1 = 0;	//选择电平触发方式
	IP = 0;	//低优先级
	while (1) {
		delay(100);
	}
}