/**************************************************************************
* @brief : C51 32×16点阵
* @author : fuqingchen@whut.edu.cn
* @data : 2018-11-4 22:18:51
***************************************************************************/
#include <reg51.h>
#define PinR0 P0
#define PinR1 P2
#define PinC  P1
#define NumR  16
#define NumC  16

unsigned char dragon[] = {
	0x00,0x00,0x00,0x00,0x00,0x00,0x00,0x00,	//R0C0
	0x03,0x00,0x00,0x00,0x01,0x03,0x03,0x7F, 	//R0C1
	0xFF,0xBF,0xFD,0xF5,0xF4,0xF0,0x70,0x00,	//R0C2
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	0x08,0x0A,0x0A,0x0A,0x0A,0x08,0x08,0x08		//R1C3
};

void delay(unsigned int t){
	unsigned char i;
	while(t--)
		{
		for(i = 0;i < 120;i++);
	}
}

void main() {
	unsigned char c_No = 0;	//列序号
	unsigned char U2 = 0, U3 = 0;
	while (1) {
		for (c_No = 0; c_No < NumC; c_No++) {	//两行同时扫描
			U2 = c_No % 16;
			U3 = U2 << 4;
			PinC = U2 | U3;
			PinR0 = ~dragon[c_No];
			PinR1 = ~dragon[c_No + 32];
			delay(4);
			PinR0 = 0xff;
			PinR1 = 0xff;
		}
	}
}
